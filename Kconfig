## Kconfig
```kconfig
#
# For a description of the syntax of this configuration file,
# see Documentation/kbuild/kconfig-language.txt.
#
mainmenu "Linux/$ARCH $KERNELVERSION Kernel Configuration"

config SRCARCH
	string
	option env="SRCARCH"

source "arch/$SRCARCH/Kconfig"
##//*YUNOS BEGIN*/
##//##module(MAKE-CONFIG)
##//##date:2014-02-11 ##author:jian.hj
source "aliyun/security/stub/Kconfig"
##//*YUNOS END*/
```

## aliyun/security/stub/Kconfig
```kconfig
menuconfig ALIYUNOS_SECURITY_SOLUTION
        bool "YUNOS SECURITY properity Configuration"
        help
            Check this to enable Yunos Security properity configuration.

if ALIYUNOS_SECURITY_SOLUTION

config ALIYUNOS_SECURITY_MODE
	tristate "Enable yunos security mode"	

config ALIYUNOS_DOMAIN
        tristate "Enable yunos domain security control"

config ALIYUNOS_AUDIT
        tristate "Enable yunos security audit"

config ALIYUNOS_PIGGY
	tristate "Enable yunos security kernel image encrypt"

endif
```

## drivers/misc/mediatek/touchkey/Kconfig
```kconfig
config MTK_TOUCHKEY
  bool CONFIG_MTK_TOUCHKEY
  default n
  help
    CONFIG_MTK_TOUCHKEY
```
